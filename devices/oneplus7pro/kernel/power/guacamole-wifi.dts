/dts-v1/;
/plugin/;
/* Supplies follow guacamole's downstream 18821 sm8150.dtsi cnss node.
 * Do not copy hotdog's extra L10C vote: guacamole uses L10C for audio.
 */
&wifi {
    vdd-0.8-cx-mx-supply = <&vreg_l1a_0p75>;
    vdd-1.8-xo-supply = <&vreg_l7a_1p8>;
    vdd-1.3-rfa-supply = <&vreg_l2c_1p3>;
    vdd-3.3-ch0-supply = <&vreg_l11c_3p3>;
    status = "okay";
};
